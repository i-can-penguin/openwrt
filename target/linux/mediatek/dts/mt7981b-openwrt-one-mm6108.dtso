// SPDX-License-Identifier: GPL-2.0-or-later OR MIT
/*
 * Copyright (C) 2025
 * Author: Mark Birss <mark.birss@gmail.com>
 */

/dts-v1/;
/plugin/;

#include <dt-bindings/gpio/gpio.h>

/ {
	compatible = "openwrt,one", "mediatek,mt7981";

        fragment@0 {
                target = <&spi1>;
                __overlay__ {
                        pinctrl-names = "default"; 
                        #address-cells = <1>;
                        #size-cells = <0>;
                        status = "okay";
                        
                        cd-gpios = <&pio 25 GPIO_ACTIVE_HIGH>;
                        
                        mm6108: mm6108@0 {
                                compatible = "morse,mm610x-spi";
                                reg = <0>;
                                reset-gpios = <&pio 2 0>;
                                power-gpios = <&pio 12 0>;
                                spi-irq-gpios = <&pio 10 0>;
                                spi-max-frequency = <50000000>;
                                status = "okay";
                        	};                     
        	 };
 	};    
};
